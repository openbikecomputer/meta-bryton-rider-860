## conf/layer.conf
```bitbake
# We have a conf and classes directory, add to BBPATH
BBPATH .= ":${LAYERDIR}"

# We have recipes-* directories, add to BBFILES
BBFILES += "${LAYERDIR}/recipes-*/*/*.bb \
            ${LAYERDIR}/recipes-*/*/*.bbappend"

BBFILE_COLLECTIONS += "brytonrider860"
BBFILE_PATTERN_brytonrider860 = "^${LAYERDIR}/"
BBFILE_PRIORITY_brytonrider860 = "6"

LAYERDEPENDS_brytonrider860 = "core"
LAYERSERIES_COMPAT_brytonrider860 = "kirkstone"
```

## wic/sdimage-brytonrider860.wks
```
# short-description: Create Bryton Rider 860 SD card image

part /boot --source bootimg-partition --ondisk mmcblk0 --fstype=vfat --label boot --active --align 4096 --size 20
part / --source rootfs --ondisk mmcblk0 --fstype=ext4 --label root --align 4096
```
